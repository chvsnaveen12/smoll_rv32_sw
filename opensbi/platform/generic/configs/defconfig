## opensbi/platform/generic/configs/defconfig
```kconfig
CONFIG_PLATFORM_ALLWINNER_D1=n
CONFIG_PLATFORM_ANDES_AE350=n
CONFIG_PLATFORM_RENESAS_RZFIVE=n
CONFIG_PLATFORM_SIFIVE_FU540=n
CONFIG_PLATFORM_SIFIVE_FU740=n
CONFIG_PLATFORM_SOPHGO_SG2042=n
CONFIG_PLATFORM_STARFIVE_JH7110=n
CONFIG_PLATFORM_THEAD=n
CONFIG_FDT_CPPC=n
CONFIG_FDT_CPPC_RPMI=n
CONFIG_FDT_GPIO=n
CONFIG_FDT_GPIO_DESIGNWARE=n
CONFIG_FDT_GPIO_SIFIVE=n
CONFIG_FDT_GPIO_STARFIVE=n
CONFIG_FDT_HSM=n
CONFIG_FDT_HSM_RPMI=y
CONFIG_FDT_I2C=y
CONFIG_FDT_I2C_SIFIVE=y
CONFIG_FDT_I2C_DW=y
CONFIG_FDT_IPI=y
CONFIG_FDT_IPI_MSWI=y
CONFIG_FDT_IPI_PLICSW=y
CONFIG_FDT_IRQCHIP=y
CONFIG_FDT_IRQCHIP_APLIC=y
CONFIG_FDT_IRQCHIP_IMSIC=y
CONFIG_FDT_IRQCHIP_PLIC=y
CONFIG_FDT_MAILBOX=y
CONFIG_RPMI_MAILBOX=y
CONFIG_FDT_MAILBOX_RPMI_SHMEM=y
CONFIG_FDT_REGMAP=y
CONFIG_FDT_REGMAP_SYSCON=y
CONFIG_FDT_RESET=y
CONFIG_FDT_RESET_ATCWDT200=y
CONFIG_FDT_RESET_GPIO=y
CONFIG_FDT_RESET_HTIF=y
CONFIG_FDT_RESET_RPMI=y
CONFIG_FDT_RESET_SUNXI_WDT=y
CONFIG_FDT_RESET_SG2042_HWMON_MCU=y
CONFIG_FDT_RESET_SYSCON=y
CONFIG_FDT_SERIAL=y
CONFIG_FDT_SERIAL_CADENCE=n
CONFIG_FDT_SERIAL_GAISLER=n
CONFIG_FDT_SERIAL_HTIF=n
CONFIG_FDT_SERIAL_RENESAS_SCIF=n
CONFIG_FDT_SERIAL_SHAKTI=n
CONFIG_FDT_SERIAL_SIFIVE=n
CONFIG_FDT_SERIAL_LITEX=n
CONFIG_FDT_SERIAL_UART8250=y
CONFIG_FDT_SERIAL_SMOLLUART=y
CONFIG_FDT_SERIAL_XILINX_UARTLITE=n
CONFIG_SERIAL_SEMIHOSTING=n
CONFIG_FDT_SUSPEND=y
CONFIG_FDT_SUSPEND_RPMI=y
CONFIG_FDT_TIMER=y
CONFIG_FDT_TIMER_MTIMER=y
CONFIG_FDT_TIMER_PLMT=y
CONFIG_FDT_MPXY=y
CONFIG_FDT_MPXY_RPMI_MBOX=y
CONFIG_FDT_MPXY_RPMI_CLOCK=y
CONFIG_FDT_MPXY_RPMI_SYSMSI=y
```
